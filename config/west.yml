## config/west.yml
```yaml
manifest:
  remotes:
  - name: zmkfirmware
    url-base: https://github.com/lynnlee0522 # 修改这里
  - name: nxtkb
    url-base: https://github.com/nxtkb
  - name: i-am-tc
    url-base: https://github.com/i-am-tc
  projects:
  - name: zmk
    remote: zmkfirmware
    revision: ink_rotation # 修改这里，指定分支名
    import: app/west.yml
  - name: zmk-behavior-report
    remote: nxtkb
    revision: main
    import: west.yml
  - name: cirque-input-module
    remote: i-am-tc
    revision: scroll-disable
  self:
    path: config
```
